## components/tuyaopen/Kconfig
```kconfig
# Ktuyaconf
menu "configure tuyaopen"
    orsource "src/tuya_cloud_service/Kconfig"
    orsource "src/liblwip/Kconfig"
    orsource "src/libtls/Kconfig"
    orsource "src/tal_system/Kconfig"
    orsource "src/liblvgl/Kconfig"
    orsource "src/device_driver/Kconfig"
endmenu
```

## components/tuyaopen/src/Kconfig
```kconfig
# Ktuyaconf
menu "configure tuyaopen"
    source "tuya_cloud_service/Kconfig"
    source "liblwip/Kconfig"
    source "libtls/Kconfig"
    source "tal_system/Kconfig"
    source "liblvgl/Kconfig"
    source "device_driver/Kconfig"
endmenu
```

## components/tuyaopen/src/device_driver/Kconfig
```kconfig
menu "configure device driver"
    orsource "display/Kconfig"
    orsource "touch/Kconfig"
    orsource "encoder/Kconfig"
endmenu
```
